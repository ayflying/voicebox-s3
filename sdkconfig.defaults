## sdkconfig.defaults
```kconfig
# ESP32-S3 语音对讲固件 默认配置
# 目标：esp32s3，16MB flash，OCT PSRAM 80M，OTA 双槽，本地 TTS 启用

CONFIG_IDF_TARGET="esp32s3"

# 主频 / PSRAM
CONFIG_ESP32S3_DEFAULT_CPU_FREQ_240=y
CONFIG_SPIRAM=y
CONFIG_SPIRAM_MODE_OCT=y
CONFIG_SPIRAM_SPEED_80M=y
CONFIG_SPIRAM_MALLOC_ALWAYSINTERNAL=16384

# Flash 16MB
CONFIG_ESPTOOLPY_FLASHSIZE_16MB=y

# 分区表（自定义 OTA 双槽 + voice_data）
CONFIG_PARTITION_TABLE_CUSTOM=y
CONFIG_PARTITION_TABLE_CUSTOM_FILENAME="partitions.csv"

# 本地 TTS（esp-sr 内置 esp_tts，关闭 MultiNet/WakeNet 以省空间）
CONFIG_ESP_TTS_ENABLED=y

# HTTPS 网关使用 ESP-IDF 根证书包验证服务器证书。
CONFIG_MBEDTLS_CERTIFICATE_BUNDLE=y

# OTA 回滚保护
CONFIG_BOOTLOADER_APP_ROLLBACK_ENABLE=y
CONFIG_APP_ROLLBACK_ENABLE=y

# 看门狗
CONFIG_ESP_TASK_WDT_TIMEOUT_S=30

# LVGL：外置 UTF-8 中文二进制字库通过 font_data 分区内存映射加载。
# 内置思源黑体只保留为外置资源未烧录时的故障降级字体。
CONFIG_LV_FONT_SOURCE_HAN_SANS_SC_16_CJK=y
CONFIG_LV_FONT_DEFAULT_SOURCE_HAN_SANS_SC_16_CJK=y
CONFIG_LV_USE_FS_MEMFS=y
CONFIG_LV_FS_MEMFS_LETTER=77
CONFIG_LV_USE_LOG=0
```
